/*
 * Copyright (c) 2020 The ZMK Contributors
 *
 * SPDX-License-Identifier: MIT
 */

#include "wendigo_oled.dtsi"


&pro_micro_i2c {
    status = "okay";

    oled: ssd1306@3c {
        compatible = "solomon,ssd1306fb";
        reg = <0x3c>;
        width = <128>;
        height = <32>;
        segment-offset = <2>;
        page-offset = <0>;
        display-offset = <0>;
        multiplex-ratio = <31>;
        segment-remap;
         com-invdir;
        com-sequential;
        inversion-on;
        prechargep = <0x22>;
    };
};


/ {
	chosen {
		zmk,kscan = &kscan0;
		zephyr,display = &oled;
	};
};